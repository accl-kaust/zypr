/include/ "system-conf.dtsi"
/include/ "udmabuf.dtsi"
/ {
chosen {
		bootargs = "earlycon console=ttyPS0,115200 clk_ignore_unused root=/dev/mmcblk0p2 rw rootwait uio_pdrv_genirq.of_id=generic-uio";
        };
};

&zycap_0{
    compatible = "generic-uio";
};

&partial_led_test_v1_0_0{
    compatible = "generic-uio";
};